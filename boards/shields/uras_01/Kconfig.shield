## boards/shields/uras_01/Kconfig.shield
```kconfig
# Copyright (c) 2020 Ryan Cross
# SPDX-License-Identifier: MIT

config SHIELD_URAS_01_CENTRAL
    def_bool $(shields_list_contains,uras_01_central)

config SHIELD_URAS_01_LEFT
    def_bool $(shields_list_contains,uras_01_left)

config SHIELD_URAS_01_RIGHT
    def_bool $(shields_list_contains,uras_01_right)
```
